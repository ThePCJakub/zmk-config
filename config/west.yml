## config/west.yml
```yaml
manifest:
  remotes:
  - name: zmkfirmware
    url-base: https://github.com/zmkfirmware
  - name: petejohanson
    url-base: https://github.com/petejohanson
  - name: caksoylar
    url-base: https://github.com/caksoylar
  - name: kilipan
    url-base: https://github.com/kilipan
  - name: grassfedreeve
    url-base: https://github.com/grassfedreeve
  projects:
  - name: zmk
    remote: zmkfirmware
    revision: main
    import: app/west.yml
    # - name: zmk
    # remote: petejohanson
    # revision: feat/pointers-move-scroll
    # import: app/west.yml
  - name: zmk-rgbled-widget
    remote: caksoylar
    revision: main
  - name: zmk-keyboards-zilpzalp
    remote: grassfedreeve
    revision: main
  self:
    path: config
```
